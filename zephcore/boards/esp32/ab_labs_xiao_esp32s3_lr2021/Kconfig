## zephcore/boards/esp32/ab_labs_xiao_esp32s3_lr2021/board.yml
```yaml
# SPDX-License-Identifier: MIT

board:
  name: ab_labs_xiao_esp32s3_lr2021
  full_name: AB Labs XIAO ESP32-S3 + Wio-LR2021 carrier
  vendor: seeed
  socs:
    - name: esp32s3
```

## zephcore/boards/nrf52840/ab_labs_xiao_nrf52840_lr2021/Kconfig.ab_labs_xiao_nrf52840_lr2021
```kconfig
# Copyright (c) 2026 ZephCore
# SPDX-License-Identifier: MIT

config BOARD_AB_LABS_XIAO_NRF52840_LR2021
	select SOC_NRF52840_QIAA
```

## zephcore/boards/nrf52840/ab_labs_xiao_nrf52840_lr2021/board.yml
```yaml
# Copyright (c) 2026 ZephCore
# SPDX-License-Identifier: MIT

board:
  name: ab_labs_xiao_nrf52840_lr2021
  full_name: AB Labs XIAO nRF52840 + Wio-LR2021 carrier
  vendor: seeed
  socs:
  - name: nrf52840
```

## zephcore/boards/nrf54l/ab_labs_xiao_nrf54l15_lr2021/Kconfig.defconfig
```kconfig
# Copyright (c) 2026 ZephCore
# SPDX-License-Identifier: MIT

if BOARD_AB_LABS_XIAO_NRF54L15_LR2021_NRF54L15_CPUAPP

config HAS_BT_CTLR
	default BT

endif # BOARD_AB_LABS_XIAO_NRF54L15_LR2021_NRF54L15_CPUAPP
```

## zephcore/boards/nrf54l/ab_labs_xiao_nrf54l15_lr2021/board.yml
```yaml
# Copyright (c) 2026 ZephCore
# SPDX-License-Identifier: MIT

board:
  name: ab_labs_xiao_nrf54l15_lr2021
  full_name: AB Labs XIAO nRF54L15 + Wio-LR2021 carrier
  vendor: seeed
  socs:
    - name: nrf54l15
```
